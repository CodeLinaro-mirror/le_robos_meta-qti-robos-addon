## conf/layer.conf
```bitbake
BBFILES += "${LAYERDIR}/recipes/*/*.bb ${LAYERDIR}/recipes/*/*/*.bb"
BBPATH .= ":${LAYERDIR}"
BBFILE_COLLECTIONS += "qti-robos-addon"
BBFILE_PRIORITY_qti-robos-addon = "17"
BBFILE_PATTERN_qti-robos-addon := "^${LAYERDIR}/"
LAYERSERIES_COMPAT_qti-robos-addon = "kirkstone scarthgap wrynose"
```
